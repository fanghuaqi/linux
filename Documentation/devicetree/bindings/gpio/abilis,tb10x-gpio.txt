## Documentation/devicetree/bindings/gpio/abilis,tb10x-gpio.txt
```
* Abilis TB10x GPIO controller

Required Properties:
- compatible: Should be "abilis,tb10x-gpio"
- reg: Address and length of the register set for the device
- gpio-controller: Marks the device node as a gpio controller.
- #gpio-cells: Should be <1>;
- gpio-base: GPIO pin index of the first GPOI managed by this controller.
- gpio-pins: Pointer to the pin configuration node inside an
  "abilis,tb10x-iomux"-compatible pin controller this GPIO controller is
  managing.

Optional Properties:
- interrupt-controller: Marks the device node as an interrupt controller.
- #interrupt-cells: Should be <1>.
- interrupts: Defines the interrupt line connecting this GPIO controller to
  its parent interrupt controller.
- interrupt-parent: Defines the parent interrupt controller.

Example:

gpioa: gpio@FF140000 {
	compatible = "abilis,tb10x-gpio";
	interrupt-controller;
	#interrupt-cells = <1>;
	interrupt-parent = <&tb10x_ictl>;
	interrupts = <27 1>;
	reg = <0xFF140000 0x1000>;
	gpio-controller;
	#gpio-cells = <1>;
	gpio-count = <3>;
	gpio-base  = <0>;
	gpio-pins = <&pctl_gpio_a>;
};
```

## Documentation/devicetree/bindings/pinctrl/abilis,tb10x-iomux.txt
```
Abilis Systems TB10x pin controller
===================================

Required properties
-------------------

- #address-cells: should be <1>.
- #size-cells: should be <1>;
- compatible: should be "abilis,tb10x-iomux";
- reg: should contain the physical address and size of the pin controller's
  register range.


Port definitions
----------------

Ports are defined (and referenced) by sub-nodes of the pin controller. Every
sub-node defines exactly one port (i.e. a set of pins). Ports are defined by
their names in the pin controller driver.

Required port definition subnode properties:
  - pingrp: should be set to the name of the port's pin group.

The following pin groups are available:
  - GPIO ports: gpioa_pins, gpiob_pins, gpioc_pins, gpiod_pins, gpioe_pins,
                gpiof_pins, gpiog_pins, gpioh_pins, gpioi_pins, gpioj_pins,
                gpiok_pins, gpiol_pins, gpiom_pins, gpion_pins
  - Serial TS input ports: mis0_pins, mis1_pins, mis2_pins, mis3_pins,
                           mis4_pins, mis5_pins, mis6_pins, mis7_pins
  - Parallel TS input ports: mip1_pins, mip3_pins, mip5_pins, mip7_pins
  - Serial TS output ports: mos0_pins, mos1_pins, mos2_pins, mos3_pins
  - Parallel TS output port: mop_pins
  - CI+ port: ciplus_pins
  - CableCard (Mcard) port: mcard_pins
  - Smart card ports: stc0_pins, stc1_pins
  - UART ports: uart0_pins, uart1_pins
  - SPI ports: spi1_pins, spi3_pins
  - JTAG: jtag_pins

All other ports of the chip are not multiplexed and thus not managed by this
driver.


Pinmux driver control
---------------------

In case a driver requires a port to be mapped, the corresponding node should
be compatible with "abilis,simple-pinctrl" and define a pinctrl state named
"abilis,simple-default" pointing to the port's respective node inside the pin
controller. Drivers managing pin controller states internally can be
configured normally as described in the pinctrl-bindings.txt.

The pinmux driver is connected to the TB10x GPIO driver in a way that a GPIO
node managing a GPIO port can point to the respective pinmux subnode using
the gpio-pins property


Example
-------

iomux: iomux@FF10601c {
	#address-cells = <1>;
	#size-cells = <1>;
	compatible = "abilis,tb10x-iomux";
	reg = <0xFF10601c 0x4>;
	pctl_gpio_a: pctl-gpio-a {
		pingrp = "gpioa_pins";
	};
	pctl_uart0: pctl-uart0 {
		pingrp = "uart0_pins";
	};
};
uart@FF100000 {
	compatible = "snps,dw-apb-uart",
			"abilis,simple-pinctrl";
	reg = <0xFF100000 0x100>;
	clock-frequency = <166666666>;
	interrupts = <25 1>;
	reg-shift = <2>;
	reg-io-width = <4>;
	pinctrl-names = "abilis,simple-default";  /* <<<<<<<< */
	pinctrl-0 = <&pctl_uart0>;                /* <<<<<<<< */
};
gpioa: gpio@FF140000 {
	compatible = "abilis,tb10x-gpio";
	reg = <0xFF140000 0x1000>;
	gpio-controller;
	#gpio-cells = <1>;
	gpio-count = <3>;
	gpio-base  = <0>;
	gpio-pins = <&pctl_gpio_a>;               /* <<<<<<<< */
};
```

## arch/arc/plat-eznps/Kconfig
```kconfig
# For a description of the syntax of this configuration file,
# see Documentation/kbuild/kconfig-language.txt.

menuconfig ARC_PLAT_EZNPS
        bool "\"EZchip\" ARC dev platform"
        select CMDLINE_UBOOT
        select CPU_BIG_ENDIAN
        select EZNPS_NET if ETHERNET
        select ARC_HAS_COH_CACHES if SMP
	select ARC_HAS_COH_RTSC if SMP
        help
          Support for ARC development platforms, provided by EZchip.
          These are based on FPGA or nSIM. e.g.
          - HE0
          - HE1
          - MetaWare nSIM
```

## arch/arc/plat-xplorer/Kconfig
```kconfig
#
# Copyright (C) 2013 Synopsys, Inc. (www.synopsys.com)
#
# This program is free software; you can redistribute it and/or modify
# it under the terms of the GNU General Public License version 2 as
# published by the Free Software Foundation.
#

config ARC_PLAT_XPLORER
	bool "Synopsys ARC Xplorer System"
	select COMMON_CLK
	select DW_APB_ICTL
	select ARCH_WANT_OPTIONAL_GPIOLIB
	help
	  Support for the ARC Xplorer System.

	  The ARC Xplorer System consists of a mainboard with peripherals,
	  on which several daughter cards can be placed. The daughter cards
	  typically contain a CPU and memory.

if ARC_PLAT_XPLORER

config XPLORER_CPUTILE_770
	select DW_APB_GPIO_INTC
	bool "ARC Xplorer CPU Tile with 770D/EM6/AS221"
	help
	  This adds support for the 770D/EM6/AS221 CPU Tile. Only the ARC
	  770D is supported in Linux.

	  The ARC Xplorer System 770D/EM6/AS221 consists of an ARC Xplorer
	  System mainboard with this daughtercard. Please use the
	  xplorer_system_770.dts device tree with this configuration.

config XPLORER_ADV7511
	bool "ADI ADV7511"
	depends on FB_ARCPGU && I2C
	default y
	select REGMAP_I2C
	select HDMI
	help 
	  This adds support for ADV7511 HDMI transmitter.

endif
```
